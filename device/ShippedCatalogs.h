#pragma once

// The shipped language catalogs and the version, as data of the firmware (device/ShippedAssets.h, generated by
// scripts/gen_device_assets.py from the same files the simulator reads from disk).

#include <functional>
#include <string>
#include <string_view>

#include <i18n/Translator.h>

#include "Esp32Heap.h"
#include "ShippedAssets.h"

namespace shipped {

inline void addTo(i18n::Translator& translator, std::string_view text, bool web) {
  i18n::Catalog catalog;
  if (!catalog.parse(text.data(), text.size())) return;
  if (web) translator.addWeb(catalog);
  else translator.add(catalog);
}

// The device's catalogs now, the page's when the page asks for them (they are let go when it is gone).
// `log` (optional) gets one line when the page's catalogs are read, with the memory before and after: the
// first request of the page after login parses them, and the device log should show whether that squeezes
// the heap.
inline void load(i18n::Translator& translator, std::function<void(const std::string&)> log = nullptr) {
  addTo(translator, kLangEn, false);
  addTo(translator, kLangDe, false);
  addTo(translator, kLangFr, false);
  translator.setWebShippedSource([log](i18n::Translator& t) {
    const std::string before = log ? heapSummary() : std::string();
    addTo(t, kWebEn, true);
    addTo(t, kWebDe, true);
    addTo(t, kWebFr, true);
    if (log) log("Web catalogs loaded (before: " + before + "; after: " + heapSummary() + ")");
  });
}

inline std::string version() { return std::string(kVersion); }

}  // namespace shipped
